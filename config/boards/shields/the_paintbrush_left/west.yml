## config/boards/shields/the_paintbrush_left/west.yml
```yaml
manifest:
  remotes:
    - name: zmkfirmware
      url-base: https://github.com/artseyio
  projects:
    - name: zmk
      remote: zmkfirmware
      revision: artsey
      import: app/west.yml
  self:
    path: config
```
